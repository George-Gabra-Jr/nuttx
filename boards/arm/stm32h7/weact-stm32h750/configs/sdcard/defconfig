## boards/arm/stm32h7/weact-stm32h750/configs/sdcard/defconfig
```kconfig
#
# Minimal SDCARD configuration for WeAct STM32H750 with 128KB flash constraint
#
# CONFIG_MMCSD_HAVE_WRITEPROTECT is not set
# CONFIG_MMCSD_MMCSUPPORT is not set
# CONFIG_STANDARD_SERIAL is not set
# CONFIG_STM32H7_USE_LEGACY_PINMAP is not set
CONFIG_ARCH="arm"
CONFIG_ARCH_BOARD="weact-stm32h750"
CONFIG_ARCH_BOARD_WEACT_STM32H750=y
CONFIG_ARCH_CHIP="stm32h7"
CONFIG_ARCH_CHIP_STM32H750IB=y
CONFIG_ARCH_CHIP_STM32H7=y
CONFIG_ARCH_CHIP_STM32H7_CORTEXM7=y
CONFIG_ARMV7M_DCACHE=y
CONFIG_ARMV7M_ICACHE=y
CONFIG_BOARD_LOOPSPERMSEC=43103
CONFIG_BUILTIN=y
# CONFIG_DEBUG_SYMBOLS is not set
CONFIG_FAT_DMAMEMORY=y
CONFIG_FAT_LCNAMES=y
CONFIG_FAT_LFN=y
CONFIG_FS_FAT=y
CONFIG_GRAN=y
CONFIG_GRAN_INTR=y
CONFIG_INIT_ENTRYPOINT="nsh_main"
# CONFIG_INTELHEX_BINARY is not set
CONFIG_MMCSD=y
CONFIG_MMCSD_SDIO=y
CONFIG_MMCSD_SDIOWAIT_WRCOMPLETE=y
CONFIG_MM_REGIONS=2
CONFIG_NSH_ARCHINIT=y
CONFIG_NSH_BUILTIN_APPS=y
CONFIG_NSH_FILEIOSIZE=256
# CONFIG_NSH_READLINE is not set
CONFIG_PREALLOC_TIMERS=2
CONFIG_RAM_SIZE=524288
CONFIG_RAM_START=0x24000000
CONFIG_RAW_BINARY=y
CONFIG_RR_INTERVAL=200
CONFIG_SCHED_HPWORK=y
CONFIG_SCHED_WAITPID=y
CONFIG_SDMMC1_SDIO_MODE=y
CONFIG_START_DAY=1
CONFIG_START_MONTH=1
CONFIG_START_YEAR=2025
CONFIG_STM32H7_SDMMC1=y
CONFIG_STM32H7_USART1=y
CONFIG_SYSTEM_NSH=y
CONFIG_TASK_NAME_SIZE=0
CONFIG_USART1_SERIAL_CONSOLE=y
```

## boards/arm/stm32h7/weact-stm32h750/configs/spiflash/defconfig
```kconfig
#
# WeAct STM32H750 configuration with external memory support
# Includes: 8MB SPI Flash, 8MB QSPI Flash
#
# CONFIG_NSH_DISABLE_IFCONFIG is not set
# CONFIG_NSH_DISABLE_PS is not set
# CONFIG_STANDARD_SERIAL is not set
# CONFIG_STM32H7_USE_LEGACY_PINMAP is not set
CONFIG_ARCH="arm"
CONFIG_ARCH_BOARD="weact-stm32h750"
CONFIG_ARCH_BOARD_WEACT_STM32H750=y
CONFIG_ARCH_CHIP="stm32h7"
CONFIG_ARCH_CHIP_STM32H750IB=y
CONFIG_ARCH_CHIP_STM32H7=y
CONFIG_ARCH_CHIP_STM32H7_CORTEXM7=y
CONFIG_ARMV7M_DCACHE=y
CONFIG_ARMV7M_ICACHE=y
CONFIG_BOARD_LOOPSPERMSEC=43103
CONFIG_BUILTIN=y
# CONFIG_DEBUG_SYMBOLS is not set

# Scheduler Configuration
CONFIG_SCHED_WORKQUEUE=y
CONFIG_SCHED_HPWORK=y
CONFIG_SCHED_HPWORKPRIORITY=224
CONFIG_SCHED_HPWORKSTACKSIZE=2048

CONFIG_EXPERIMENTAL=y
# CONFIG_HAVE_CXX is not set
# CONFIG_HAVE_CXXINITIALIZE is not set
CONFIG_INIT_ENTRYPOINT="nsh_main"
# CONFIG_INTELHEX_BINARY is not set

# MTD
CONFIG_MTD=y
CONFIG_MTD_BYTE_WRITE=y
CONFIG_MTD_W25=y
CONFIG_MTD_W25QXXXJV=y
CONFIG_MTD_SMART=y

# Memory configuration
CONFIG_MM_REGIONS=2
CONFIG_MQ_MAXMSGSIZE=64

# NSH Configuration
CONFIG_NSH_ARCHINIT=y
CONFIG_NSH_BUILTIN_APPS=y
CONFIG_NSH_FILEIOSIZE=512
# CONFIG_NSH_READLINE is not set

# System configuration
CONFIG_PREALLOC_TIMERS=2
CONFIG_RAM_SIZE=524288
CONFIG_RAM_START=0x24000000
CONFIG_RAW_BINARY=y
CONFIG_RR_INTERVAL=200
CONFIG_SCHED_WAITPID=y

# SPI Configuration
CONFIG_SPI=y
CONFIG_SPI_CMDDATA=y
CONFIG_STM32H7_SPI1=y

# Date and time
CONFIG_START_DAY=1
CONFIG_START_MONTH=1
CONFIG_START_YEAR=2025

# Serial console
CONFIG_STM32H7_USART1=y
CONFIG_USART1_SERIAL_CONSOLE=y

# System components
CONFIG_SYSTEM_NSH=y
CONFIG_TASK_NAME_SIZE=0
```

## boards/arm/stm32h7/weact-stm32h750/configs/st7735/defconfig
```kconfig
#
# Minimal ST7735 LCD configuration for WeAct STM32H750
# Includes: ST7735 LCD
#
# CONFIG_NSH_DISABLE_IFCONFIG is not set
# CONFIG_NSH_DISABLE_PS is not set
# CONFIG_STANDARD_SERIAL is not set
# CONFIG_STM32H7_USE_LEGACY_PINMAP is not set
CONFIG_ARCH="arm"
CONFIG_ARCH_BOARD="weact-stm32h750"
CONFIG_ARCH_BOARD_WEACT_STM32H750=y
CONFIG_ARCH_CHIP="stm32h7"
CONFIG_ARCH_CHIP_STM32H750IB=y
CONFIG_ARCH_CHIP_STM32H7=y
CONFIG_ARCH_CHIP_STM32H7_CORTEXM7=y
CONFIG_ARMV7M_DCACHE=y
CONFIG_ARMV7M_ICACHE=y
CONFIG_BOARD_LOOPSPERMSEC=43103
CONFIG_BUILTIN=y
# CONFIG_DEBUG_SYMBOLS is not set

# Drivers
CONFIG_DRIVERS_VIDEO=y

# Example applications
CONFIG_EXAMPLES_FB=y
CONFIG_EXAMPLES_NXHELLO=y
CONFIG_EXAMPLES_NXLINES=y
CONFIG_EXAMPLES_NXLINES_BGCOLOR=0x0000
CONFIG_EXAMPLES_NXLINES_LINECOLOR=0xF800
CONFIG_EXAMPLES_NXLINES_LINEWIDTH=2

CONFIG_EXPERIMENTAL=y
# CONFIG_HAVE_CXX is not set
# CONFIG_HAVE_CXXINITIALIZE is not set
CONFIG_INIT_ENTRYPOINT="nsh_main"
# CONFIG_INTELHEX_BINARY is not set

# LCD ST7735 - Based on official ST7735S datasheet v1.5
CONFIG_LCD=y
CONFIG_LCD_FRAMEBUFFER=y
CONFIG_LCD_NOGETRUN=y
# CONFIG_LCD_PORTRAIT is not set
CONFIG_LCD_ST7735=y
CONFIG_LCD_ST7735_GM11=y
CONFIG_LCD_ST7735_BGR=y
CONFIG_LCD_ST7735_INVCOLOR=y
CONFIG_LCD_ST7735_BPP=16
CONFIG_LCD_ST7735_SPIMODE=0

# Memory configuration
CONFIG_MM_REGIONS=2
CONFIG_MQ_MAXMSGSIZE=64

# NSH Configuration
CONFIG_NSH_ARCHINIT=y
CONFIG_NSH_BUILTIN_APPS=y
CONFIG_NSH_FILEIOSIZE=256
# CONFIG_NSH_READLINE is not set

# NX Graphics
CONFIG_NX=y
CONFIG_NX_BLOCKING=y
CONFIG_NX_DISABLE_16BPP=n
CONFIG_NX_NPLANES=1
CONFIG_NX_WRITEONLY=y
CONFIG_NXFONT_MONO5X8=y

# System configuration
CONFIG_PREALLOC_TIMERS=2
CONFIG_RAM_SIZE=524288
CONFIG_RAM_START=0x24000000
CONFIG_RAW_BINARY=y
CONFIG_RR_INTERVAL=200
CONFIG_SCHED_WAITPID=y

# SPI Configuration
CONFIG_SPI_CMDDATA=y
CONFIG_STM32H7_SPI4=y

# Date and time
CONFIG_START_DAY=1
CONFIG_START_MONTH=1
CONFIG_START_YEAR=2025

# Serial console
CONFIG_STM32H7_USART1=y
CONFIG_USART1_SERIAL_CONSOLE=y

# System components
CONFIG_SYSTEM_NSH=y
CONFIG_TASK_NAME_SIZE=0

# Video framebuffer
CONFIG_VIDEO_FB=y
```

## boards/arm/stm32h7/weact-stm32h750/configs/usbnsh/defconfig
```kconfig
#
# Minimal USB NSH configuration for WeAct STM32H750 with 128KB flash constraint
#
# CONFIG_NSH_DISABLE_IFCONFIG is not set
# CONFIG_NSH_DISABLE_PS is not set
# CONFIG_STANDARD_SERIAL is not set
# CONFIG_STM32H7_USE_LEGACY_PINMAP is not set
CONFIG_ARCH="arm"
CONFIG_ARCH_BOARD="weact-stm32h750"
CONFIG_ARCH_BOARD_WEACT_STM32H750=y
CONFIG_ARCH_CHIP="stm32h7"
CONFIG_ARCH_CHIP_STM32H750IB=y
CONFIG_ARCH_CHIP_STM32H7=y
CONFIG_ARCH_CHIP_STM32H7_CORTEXM7=y
CONFIG_ARMV7M_DCACHE=y
CONFIG_ARMV7M_ICACHE=y
CONFIG_BOARDCTL_IOCTL=y
CONFIG_BOARDCTL_USBDEVCTRL=y
CONFIG_BOARD_LOOPSPERMSEC=43103
CONFIG_BUILTIN=y
CONFIG_CDCACM=y
CONFIG_CDCACM_CONSOLE=y
# CONFIG_DEBUG_SYMBOLS is not set
CONFIG_EXPERIMENTAL=y
# CONFIG_HAVE_CXX is not set
# CONFIG_HAVE_CXXINITIALIZE is not set
CONFIG_INIT_ENTRYPOINT="nsh_main"
# CONFIG_INTELHEX_BINARY is not set
CONFIG_MM_REGIONS=2
CONFIG_NSH_BUILTIN_APPS=y
CONFIG_NSH_FILEIOSIZE=256
# CONFIG_NSH_READLINE is not set
CONFIG_PREALLOC_TIMERS=2
CONFIG_RAM_SIZE=524288
CONFIG_RAM_START=0x24000000
CONFIG_RAW_BINARY=y
CONFIG_RR_INTERVAL=200
CONFIG_SCHED_WAITPID=y
CONFIG_START_DAY=1
CONFIG_START_MONTH=1
CONFIG_START_YEAR=2025
CONFIG_STM32H7_HSI48=y
CONFIG_STM32H7_OTGFS=y
CONFIG_STM32H7_USART1=y
CONFIG_SYSTEM_NSH=y
CONFIG_TASK_NAME_SIZE=0
CONFIG_USBDEV=y
```
